## firmware/esp32-p4/main/Kconfig.projbuild
```kconfig
menu "IQData gateway"
    config IQ_NTP_SERVER
        string "NTP server (empty disables synchronization)"
        default "time.cloudflare.com"
        help
            Hostname or IPv4 address of the site's NTP server. Static networks
            without DNS should use a numeric address. Events retain uptime and
            null UTC until an actual synchronization. Measurements stay in RAM.
endmenu
```

## firmware/esp32-p4/sdkconfig.defaults
```kconfig
CONFIG_IDF_TARGET="esp32p4"
CONFIG_ESP32P4_SELECTS_REV_LESS_V3=y
CONFIG_ESP32P4_REV_MIN_1=y
CONFIG_ESPTOOLPY_FLASHMODE_DIO=y
CONFIG_ESPTOOLPY_FLASHSIZE_32MB=y
CONFIG_ESPTOOLPY_FLASHFREQ_40M=y
CONFIG_COMPILER_OPTIMIZATION_SIZE=y
CONFIG_SPIRAM=y
CONFIG_SPIRAM_SPEED_200M=y
CONFIG_ESP_MAIN_TASK_STACK_SIZE=8192
CONFIG_FREERTOS_HZ=1000
CONFIG_ETH_ENABLED=y
CONFIG_ETH_USE_ESP32_EMAC=y
CONFIG_ETH_PHY_INTERFACE_RMII=y
CONFIG_LWIP_MAX_SOCKETS=16
CONFIG_LWIP_SO_REUSE=y
CONFIG_LWIP_UDP_RECVMBOX_SIZE=64
CONFIG_ESP_CONSOLE_UART_DEFAULT=y
CONFIG_PARTITION_TABLE_CUSTOM=y
CONFIG_PARTITION_TABLE_CUSTOM_FILENAME="partitions.csv"
CONFIG_ESP_TASK_WDT_EN=y
CONFIG_ESP_TASK_WDT_INIT=y
CONFIG_ESP_TASK_WDT_PANIC=y
CONFIG_ESP_TASK_WDT_TIMEOUT_S=15
CONFIG_ESP_COREDUMP_ENABLE_TO_NONE=y
CONFIG_BOOTLOADER_APP_ROLLBACK_ENABLE=y
# CONFIG_SECURE_BOOT is not set
# CONFIG_SECURE_FLASH_ENC_ENABLED is not set
# CONFIG_BOOTLOADER_APP_ANTI_ROLLBACK is not set
```
